#include <zephyr/dt-bindings/memory-attr/memory-attr.h>

/delete-node/ &storage_partition;

&mram1x {
	cpurad_rw_partitions: cpurad-rw-partitions {
		compatible = "nordic,owned-partitions", "fixed-partitions";
		status = "okay";
		nordic,access = <NRF_OWNER_ID_RADIOCORE NRF_PERM_RWS>;
		#address-cells = <1>;
		#size-cells = <1>;

		storage_partition: partition@1e3000 {
			reg = < 0x1e3000 DT_SIZE_K(24) >;
		};
	};
};
