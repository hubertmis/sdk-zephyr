## sample.yaml
```
sample:
  name: MSPI Preview
tests:
  sample.drivers.mspi.async:
    tags:
      - mspi
    harness: console
    harness_config:
      type: multi_line
      ordered: true
    depends_on: mspi
```

## prj.conf
```kconfig
CONFIG_STDOUT_CONSOLE=y
CONFIG_MSPI=y

#CONFIG_CLOCK_CONTROL=y
```

## boards/nrf54h20dk_nrf54h20_cpuapp.overlay
```dts
/*
 * Copyright (c) 2024 Nordic Semiconductor ASA
 *
 * SPDX-License-Identifier: Apache-2.0
 */

/ {
	aliases {
		dev0 = &mx25uw63;
	};
};
```

## src/main.c
```c
/*
 * Copyright 2024 Nordic Semiconductor ASA
 *
 * SPDX-License-Identifier: Apache-2.0
 */

#include <zephyr/kernel.h>
#include <zephyr/logging/log.h>
#include <zephyr/cache.h>
#include <zephyr/device.h>
#include <zephyr/devicetree.h>
#include <stdio.h>
#include <string.h>
#include <zephyr/drivers/clock_control/nrf_clock_control.h>
#include <zephyr/drivers/mspi.h>

#define MSPI_BUS                  DT_BUS(DT_ALIAS(dev0))
#define MSPI_TARGET               DT_ALIAS(dev0)

#define BUF_SIZE 1024

const uint8_t one_wire_cmd = 0x02;
const uint32_t one_wire_address = 0xaa5599;
uint8_t one_wire_params[] = {0x5a, 0xdb};

const uint8_t data_block_cmd = 0x32;
const uint32_t data_block_address = 0x002c00;
//uint8_t data_block_data[512];
// Place data in local RAM to speed up access
uint8_t *const data_block_data = (uint8_t *)0x22000000;
#define DATA_SIZE 512

const struct mspi_xfer_packet one_wire_packet[] = {
	{
		.dir                = MSPI_TX,
		.cmd                = one_wire_cmd,
		.address            = one_wire_address,
		.num_bytes          = sizeof(one_wire_params),
		.data_buf           = one_wire_params,
	},
};

const struct mspi_xfer_packet data_block_packet[] = {
	{
		.dir                = MSPI_TX,
		.cmd                = data_block_cmd,
		.address            = data_block_address,
		.num_bytes          = DATA_SIZE,
		.data_buf           = data_block_data,
	},
};

const struct mspi_xfer one_wire_xfer = {
	.xfer_mode                  = MSPI_DMA,
	.cmd_length                 = 1,
	.addr_length                = 3,
	.priority                   = 1,
	.packets                    = one_wire_packet,
	.num_packet                 = 1,
};

const struct mspi_xfer data_block_xfer = {
	.xfer_mode                  = MSPI_DMA,
	.cmd_length                 = 1,
	.addr_length                = 3,
	.priority                   = 1,
	.packets                    = data_block_packet,
	.num_packet                 = 1,
	.timeout                    = 10000,
};

enum {
	TIMESTAMP_BEFORE_ONE_WIRE,
	TIMESTAMP_AFTER_ONE_WIRE,
	TIMESTAMP_BEFORE_DATA_BLOCK,
	TIMESTAMP_AFTER_DATA_BLOCK,

	NUM_TIMESTAMPS,
};

#if DVFS
static volatile bool clock_is_set;

static void clk_callback(struct onoff_manager *srv,
		     struct onoff_client *cli,
		     uint32_t state,
		     int res)
{
	clock_is_set = true;
}
#endif

int main(void)
{
	const struct device *controller = DEVICE_DT_GET(MSPI_BUS);
	struct mspi_dev_id dev_id = MSPI_DEVICE_ID_DT(MSPI_TARGET);
	int ret;
	uint32_t timestamps[NUM_TIMESTAMPS];

 #if DVFS
	const struct nrf_clock_spec hsfll_spec = {
		.frequency = MHZ(320),
	};
	const struct device *clk_dev = DEVICE_DT_GET(DT_NODELABEL(cpuapp_hsfll));
	struct onoff_client cli = {0};
	sys_notify_init_callback(&cli.notify, clk_callback);

	ret = nrf_clock_control_request(clk_dev, &hsfll_spec, &cli);
	if (ret) {
		printk("Failed to request clock: %d\n", ret);
		return 1;
	}
	while (!clock_is_set);
	k_sleep(K_MSEC(1000));
#endif

	printk("FICR trim 320: %x %x\n", *(uint32_t *)0x0FFFE3CC, *(uint32_t *)0x0FFFE3E4);
	printk("FICR trim 256: %x %x\n", *(uint32_t *)0x0FFFE3D0, *(uint32_t *)0x0FFFE3E8);
	printk("FICR trim 128: %x %x\n", *(uint32_t *)0x0FFFE3D4, *(uint32_t *)0x0FFFE3EC);
	printk("FICR trim  64: %x %x\n", *(uint32_t *)0x0FFFE3D8, *(uint32_t *)0x0FFFE3F0);
	printk("FICR trim ZBB: %x %x\n", *(uint32_t *)0x0FFFE3DC, *(uint32_t *)0x0FFFE3F4);
	printk("HSFLL trim: %x %x\n", *(uint32_t *)0x5200D444, *(uint32_t *)0x5200D448);
	/* Initialize write buffer */
	for (int i = 0; i < DATA_SIZE; i++) {
		data_block_data[i] = (uint8_t)i;
	}

	// TODO: cache should be handled by the driver. Is this code needed here?
	ret = sys_cache_data_flush_range(data_block_data, DATA_SIZE);
	if (ret) {
		printk("Failed to flush cache\n");
		return 1;
	}

	const struct mspi_dev_cfg one_wire_cfg = {
		.freq = 32000000,
		.io_mode = MSPI_IO_MODE_SINGLE,
	};
	ret = mspi_dev_config(controller, &dev_id,
	                      MSPI_DEVICE_CONFIG_FREQUENCY |
						  MSPI_DEVICE_CONFIG_IO_MODE,
						  &one_wire_cfg);
	if (ret) {
		printk("Failed to configure mode\n");
		return 1;
	}

	timestamps[TIMESTAMP_BEFORE_ONE_WIRE] = k_cycle_get_32();
	ret = mspi_transceive(controller, &dev_id, &one_wire_xfer);
	timestamps[TIMESTAMP_AFTER_ONE_WIRE] = k_cycle_get_32();
	if (ret) {
		printk("Failed to send configuration\n");
		return 1;
	}

	const struct mspi_dev_cfg data_block_cfg = {
		.freq = 50000000,
		.io_mode = MSPI_IO_MODE_QUAD_1_1_4,
	};
	ret = mspi_dev_config(controller, &dev_id,
	                      MSPI_DEVICE_CONFIG_FREQUENCY |
						  MSPI_DEVICE_CONFIG_IO_MODE,
						  &data_block_cfg);
	if (ret) {
		printk("Failed to configure 1 1 4 mode\n");
		return 1;
	}

	timestamps[TIMESTAMP_BEFORE_DATA_BLOCK] = k_cycle_get_32();
	ret = mspi_transceive(controller, &dev_id, &data_block_xfer);
	timestamps[TIMESTAMP_AFTER_DATA_BLOCK] = k_cycle_get_32();
	if (ret) {
		printk("Failed to send data\n");
		return 1;
	}

	printk("MSPI test completed\n");

	uint32_t one_wire_cycles = timestamps[TIMESTAMP_AFTER_ONE_WIRE] - timestamps[TIMESTAMP_BEFORE_ONE_WIRE];
	uint32_t data_block_cycles = timestamps[TIMESTAMP_AFTER_DATA_BLOCK] - timestamps[TIMESTAMP_BEFORE_DATA_BLOCK];
	uint32_t one_wire_us = k_cyc_to_us_floor32(one_wire_cycles);
	uint32_t data_block_us = k_cyc_to_us_floor32(data_block_cycles);

	printk("Stats:\n");
	printk("One wire: %u cycles %u us\n", one_wire_cycles, one_wire_us);
	printk("Data block: %u cycles %u us\n", data_block_cycles, data_block_us);
	printk("Throughput: %u bytes/s\n", DATA_SIZE * 1000000 / data_block_us);

	return 0;
}
```
